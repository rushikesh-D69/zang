## firmware/zang_p4/components/app/Kconfig
```kconfig
menu "Zang app"
    config ZANG_STATE_HZ
        int "Default STATE publish rate (Hz); host can change it with CMD SET_RATE"
        range 1 100
        default 50
    config ZANG_STREAM_MIC
        bool "Stream the microphones to the host (MIC_CHUNK, 16 kHz PCM16 mono = 32 kB/s)"
        default n
    config ZANG_IMAGE_MAX_KB
        int "Largest DISPLAY_IMAGE accepted (KiB of JPEG or raw RGB565 data)"
        range 128 4096
        default 512
    config ZANG_FW_VERSION
        hex "Firmware version reported in HELLO_ACK (0xMMmm)"
        default 0x0001
endmenu
```

## firmware/zang_p4/components/audio/Kconfig
```kconfig
menu "Zang audio"
    comment "v0.0.1: NS4168 class-D amp on I2S (no codec, no MCLK) + two PDM mics (stereo L/R) on PDM RX."
    config ZANG_AUDIO_OUT_I2S_PORT
        int "I2S controller for the speaker"
        range 0 2
        default 1
    config ZANG_AUDIO_OUT_RATE
        int "Default speaker sample rate (Hz); streams and WAV files switch it"
        default 16000
    config ZANG_AUDIO_OUT_BUF_MS
        int "Speaker ring buffer (ms)"
        default 1000
    config ZANG_AUDIO_MIC_RATE
        int "Microphone sample rate (Hz, PDM2PCM)"
        default 16000
    config ZANG_AUDIO_MIC_FRAME_MS
        int "Microphone callback frame (ms)"
        default 20
    config ZANG_AUDIO_MIC_STEREO
        bool "Deliver both mics (stereo) instead of the L+R mono mix"
        default n
endmenu
```

## firmware/zang_p4/components/board/Kconfig
```kconfig
menu "Zang board pins"
    comment "Defaults = Zang board v0.0.1 schematic (docs/PINOUT.md, docs/HARDWARE_REVIEW.md). -1 = not wired."
    rsource "Kconfig.pins"

    menu "Pin polarity and bus options"
        config ZANG_SERVO_PWR_ACTIVE_HIGH
            bool "Servo power enable is active high"
            default y
        config ZANG_AMP_EN_ACTIVE_HIGH
            bool "Amplifier enable is active high"
            default y
        config ZANG_LCD_BL_ACTIVE_HIGH
            bool "Backlight is active high"
            default n
            help
                v0.0.1 drives the AO3401A P-MOSFET gate: backlight is ON when the pin is LOW.
        config ZANG_VBAT_DIVIDER_X1000
            int "Battery divider ratio x1000 (v0.0.1: 20k/10k = 3.000)"
            default 3000
        config ZANG_I2C_PORT
            int "Shared I2C controller number"
            range 0 1
            default 0
        config ZANG_I2C_FREQ_HZ
            int "Shared I2C bus frequency (Hz)"
            default 100000
            help
                100 kHz: the bus carries the OV2640 SCCB (max 400 kHz) on v0.0.1.
    endmenu
endmenu
```

## firmware/zang_p4/components/camera/Kconfig
```kconfig
menu "Zang camera (DVP)"
    config ZANG_CAMERA_ENABLE
        bool "Enable the DVP camera (OV2640 assumed, VERIFY the module)"
        default y
    config ZANG_CAMERA_XCLK_HZ
        int "XCLK frequency (Hz) generated on CAM_XCLK"
        depends on ZANG_CAMERA_ENABLE
        default 20000000
    config ZANG_CAMERA_SCCB_HZ
        int "SCCB clock (Hz)"
        depends on ZANG_CAMERA_ENABLE
        default 100000
    config ZANG_CAMERA_DEFAULT_QUALITY
        int "Default JPEG quality (1..100, higher = better)"
        depends on ZANG_CAMERA_ENABLE
        range 1 100
        default 60
        help
            The sensor compresses to JPEG itself (OV2640). CMD CAMERA_STREAM can change the quality per stream.
endmenu
```

## firmware/zang_p4/components/display/Kconfig
```kconfig
menu "Zang display (SPI TFT)"
    choice ZANG_LCD_PANEL
        prompt "Panel controller"
        default ZANG_LCD_GC9A01
        help
            The CAD chest plate has a 40 mm ROUND window (no display part in the CAD), which fits a 1.28" round
            240x240 GC9A01 module; the 12-pin FPC pinout on the schematic matches those modules too. Change it here
            if the real panel differs.
        config ZANG_LCD_ST7789
            bool "ST7789"
        config ZANG_LCD_GC9A01
            bool "GC9A01 (round 240x240)"
        config ZANG_LCD_ILI9341
            bool "ILI9341"
    endchoice
    config ZANG_LCD_WIDTH
        int "Width (px)"
        default 240
    config ZANG_LCD_HEIGHT
        int "Height (px)"
        default 320 if ZANG_LCD_ILI9341
        default 240
    config ZANG_LCD_PCLK_MHZ
        int "SPI clock (MHz): 40, 48, 60 or 80 divide cleanly from SPLL 480 MHz"
        default 60 if ZANG_LCD_ST7789
        default 40
        help
            ST7789 write cycle >= 16 ns -> 60 MHz is the highest in-spec clock (HARDWARE_REVIEW.md).
    config ZANG_LCD_SPI_MODE
        int "SPI mode"
        range 0 3
        default 0
    config ZANG_LCD_INVERT_COLOR
        bool "Invert colours (most IPS ST7789 / GC9A01 modules need this)"
        default y if ZANG_LCD_ST7789 || ZANG_LCD_GC9A01
        default n
    config ZANG_LCD_BGR
        bool "Panel is BGR"
        default y if ZANG_LCD_ILI9341 || ZANG_LCD_GC9A01
        default n
    config ZANG_LCD_X_GAP
        int "X offset into controller RAM"
        default 0
    config ZANG_LCD_Y_GAP
        int "Y offset into controller RAM"
        default 0
    config ZANG_LCD_LINES_PER_BUF
        int "Lines per DMA buffer (two buffers in internal RAM)"
        default 20
    config ZANG_LCD_FPS
        int "Animation frame rate target"
        default 30
    config ZANG_LCD_SELF_TEST
        bool "Measure and log full-frame and partial-update FPS at boot"
        default y
endmenu
```

## firmware/zang_p4/components/imu/Kconfig
```kconfig
menu "Zang IMU (optional)"
    config ZANG_IMU_ENABLE
        bool "QMI8658 IMU on the shared I2C bus"
        default n
        help
            Board v0.0.1 has NO IMU (HARDWARE_REVIEW.md finding 5). STATE then reports rpy/gyro/acc = 0x7FFF.
            A learned balance policy needs one: add a QMI8658C on I2C (GPIO17/18) on v0.0.2.
    config ZANG_IMU_I2C_ADDR
        hex "I2C address (0x6B with SA0 high, 0x6A low)"
        depends on ZANG_IMU_ENABLE
        default 0x6B
    config ZANG_IMU_RATE_HZ
        int "Sampling / filter rate (Hz)"
        depends on ZANG_IMU_ENABLE
        default 200
endmenu
```

## firmware/zang_p4/components/motion/Kconfig
```kconfig
menu "Zang motion"
    config ZANG_MOTION_PERIOD_MS
        int "Servo update period (ms)"
        range 5 100
        default 20
        help
            20 ms = 50 Hz. With per-servo writes at 115200 baud, 15 goals take ~14 ms, so periods below 20 ms
            need SYNC WRITE or a faster bus.
    config ZANG_MOTION_WATCHDOG_MS
        int "Stream watchdog: HOLD after this long without any frame from the host (ms)"
        default 500
    config ZANG_MOTION_STALE_MS
        int "Drop targets/keys more than this far in the past (ms)"
        default 200
    config ZANG_MOTION_READS_PER_CYCLE
        int "Servo position reads per cycle (round robin)"
        range 0 15
        default 1
    config ZANG_MOTION_FILE_LEAD_MS
        int "Lead time before a .zact file's frame 0 (ms), to move smoothly from the current pose"
        default 400
    config ZANG_MOTION_ALLOW_UNCALIBRATED
        bool "Allow torque on without a stored calibration (bench bring-up only)"
        default n
        help
            With default calibration (zero = mid travel, sign +1) every joint may jump on torque-on.
endmenu
```

## firmware/zang_p4/components/net/Kconfig
```kconfig
menu "Zang network"
    config ZANG_WIFI_SSID
        string "Default Wi-Fi SSID (used when NVS has none)"
        default ""
    config ZANG_WIFI_PASSWORD
        string "Default Wi-Fi password"
        default ""
    config ZANG_HOSTNAME
        string "mDNS / DHCP hostname"
        default "zang"
endmenu
```

## firmware/zang_p4/components/servo_bus/Kconfig
```kconfig
menu "Zang servo bus"
    config ZANG_SERVO_UART_PORT
        int "UART controller for the servo bus"
        range 1 4
        default 1
    config ZANG_SERVO_BAUD
        int "Servo bus baud rate"
        default 115200
        help
            Zing ran DS servos at 115200. At that rate one goal packet (11 B) takes ~0.95 ms, so 15 servos need
            ~14 ms per cycle with per-servo writes. Raise only after confirming the DS-R003G supports it.
    config ZANG_SERVO_TX_OPEN_DRAIN
        bool "Drive the TX pin open-drain"
        default y
        help
            v0.0.1 rework: SS_P is wired straight to GPIO47 and the bus is pulled up by 1k on the board, and SS_N
            to GPIO48. Open-drain TX lets servos and the P4 share the line without fighting.
    config ZANG_SERVO_SINGLE_WIRE_ECHO
        bool "Single-wire bus: every transmitted byte is echoed back on RX"
        default y
        help
            True for a TX/RX tied single wire (Zing's wiring). Disable when SERVO_DIR drives a buffer that
            isolates RX during transmit.
    config ZANG_SERVO_SYNC_WRITE
        bool "Use SYNC WRITE (0x83) for multi-servo goals (UNVERIFIED on DS-R003G)"
        default n
        help
            One 83-byte packet for all 15 servos instead of 15 x 11 bytes. Enable only after a bench test.
    config ZANG_SERVO_REPLY_TIMEOUT_MS
        int "Reply timeout (ms)"
        default 10
endmenu
```

## firmware/zang_p4/components/storage/Kconfig
```kconfig
menu "Zang storage (SD card)"
    choice ZANG_SD_MODE
        prompt "SD card interface"
        default ZANG_SD_SDMMC_4BIT
        config ZANG_SD_SDMMC_4BIT
            bool "SDMMC 4-bit"
        config ZANG_SD_SDMMC_1BIT
            bool "SDMMC 1-bit"
        config ZANG_SD_SPI
            bool "SPI"
    endchoice
    config ZANG_SD_SDMMC_SLOT
        int "SDMMC slot (0 = IOMUX pins 39-44 fixed, 1 = any GPIO via matrix)"
        depends on !ZANG_SD_SPI
        range 0 1
        default 1
    config ZANG_SD_LDO_CHAN
        int "On-chip LDO channel powering the SD IO domain (-1 = external supply; P4 EV board uses 4)"
        range -1 4
        default -1
    config ZANG_SD_SPI_HOST
        int "SPI host for SD (SPI mode)"
        depends on ZANG_SD_SPI
        range 1 2
        default 2
    config ZANG_SD_MAX_FILES
        int "Max open files"
        default 8
    config ZANG_SD_FREQ_KHZ
        int "Bus frequency (kHz)"
        default 20000
endmenu
```
